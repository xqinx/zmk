## app/boards/shields/xobdox/Kconfig.defconfig
```kconfig
# Copyright (c) 2022 Xiao Qin
# SPDX-License-Identifier: MIT

if SHIELD_XOBDOX_LEFT

config ZMK_KEYBOARD_NAME
    default "oxbdox"

config ZMK_SPLIT_ROLE_CENTRAL
    default y

endif

if SHIELD_XOBDOX_LEFT || SHIELD_XOBDOX_RIGHT

config ZMK_SPLIT
    default y

endif
```

## app/boards/shields/xobdox/Kconfig.shield
```kconfig
# Copyright (c) 2022 Xiao Qin
# SPDX-License-Identifier: MIT
#
config SHIELD_XOBDOX_LEFT
    def_bool $(shields_list_contains,xobdox_left)

config SHIELD_XOBDOX_RIGHT
    def_bool $(shields_list_contains,xobdox_right)
```

## app/dts/bindings/behaviors/zmk,behavior-mouse-button.yaml
```yaml
# Copyright (c) 2023 The ZMK Contributors
# SPDX-License-Identifier: MIT

description: Mouse button press/release behavior

compatible: "zmk,behavior-mouse-button"

include: one_param.yaml
```
